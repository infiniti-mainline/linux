## Documentation/devicetree/bindings/display/panel/oneplus,aa601-p-7-a0020.yaml
```yaml
# SPDX-License-Identifier: (GPL-2.0-only OR BSD-2-Clause)
%YAML 1.2
---
$id: http://devicetree.org/schemas/display/panel/oneplus,aa601-p-7-a0020.yaml#
$schema: http://devicetree.org/meta-schemas/core.yaml#

title: OnePlus AA601 P-7-A0020 AMOLED DSI panel

maintainers:
  - Victor Fuentes <victor@vlinkz.dev>

description:
  1272x2772 DSI command mode panel with Display Stream Compression, found
  in the OnePlus 15.

allOf:
  - $ref: panel-common.yaml#

properties:
  compatible:
    const: oneplus,aa601-p-7-a0020

  reg:
    maxItems: 1

  vddio-supply: true
  vdd-supply: true
  vddr-supply: true
  vci-supply: true

required:
  - compatible
  - reg
  - reset-gpios
  - enable-gpios
  - vddio-supply
  - vdd-supply
  - vddr-supply
  - vci-supply
  - port

unevaluatedProperties: false

examples:
  - |
    #include <dt-bindings/gpio/gpio.h>

    dsi {
        #address-cells = <1>;
        #size-cells = <0>;

        panel@0 {
            compatible = "oneplus,aa601-p-7-a0020";
            reg = <0>;

            reset-gpios = <&tlmm 171 GPIO_ACTIVE_LOW>;
            enable-gpios = <&pmk8850_gpios 1 GPIO_ACTIVE_HIGH>;

            vddio-supply = <&vreg_l12b_1p8>;
            vdd-supply = <&vreg_l11b_1p2>;
            vddr-supply = <&panel_vddr>;
            vci-supply = <&vreg_l13b_3p0>;

            port {
                endpoint {
                    remote-endpoint = <&mdss_dsi0_out>;
                };
            };
        };
    };
```

## Documentation/devicetree/bindings/input/touchscreen/synaptics,s3910.yaml
```yaml
# SPDX-License-Identifier: (GPL-2.0-only OR BSD-2-Clause)
%YAML 1.2
---
$id: http://devicetree.org/schemas/input/touchscreen/synaptics,s3910.yaml#
$schema: http://devicetree.org/meta-schemas/core.yaml#

title: Synaptics S3910 TouchComm touchscreen controller

maintainers:
  - Victor Fuentes <victor@vlinkz.dev>

allOf:
  - $ref: touchscreen.yaml#
  - $ref: /schemas/spi/spi-peripheral-props.yaml#

properties:
  compatible:
    const: synaptics,s3910

  reg:
    maxItems: 1

  interrupts:
    maxItems: 1

  reset-gpios:
    maxItems: 1

  vdd-supply:
    description: 1.8 V I/O supply

  avdd-supply:
    description: Analog supply

required:
  - compatible
  - reg
  - interrupts
  - reset-gpios
  - vdd-supply
  - avdd-supply

unevaluatedProperties: false

examples:
  - |
    #include <dt-bindings/gpio/gpio.h>
    #include <dt-bindings/interrupt-controller/irq.h>

    spi {
        #address-cells = <1>;
        #size-cells = <0>;

        touchscreen@0 {
            compatible = "synaptics,s3910";
            reg = <0>;
            spi-max-frequency = <19000000>;
            interrupts-extended = <&tlmm 158 IRQ_TYPE_LEVEL_LOW>;
            reset-gpios = <&tlmm 159 GPIO_ACTIVE_LOW>;
            vdd-supply = <&vreg_l4b_1p8>;
            avdd-supply = <&touch_avdd_2v8>;
            touchscreen-size-x = <12640>;
            touchscreen-size-y = <27800>;
        };
    };
```

## Documentation/devicetree/bindings/media/i2c/ovti,ov50d40.yaml
```yaml
# SPDX-License-Identifier: (GPL-2.0-only OR BSD-2-Clause)
%YAML 1.2
---
$id: http://devicetree.org/schemas/media/i2c/ovti,ov50d40.yaml#
$schema: http://devicetree.org/meta-schemas/core.yaml#

title: OmniVision OV50D40 Image Sensor

description:
  OmniVision OV50D40 is a 50 megapixel (8192x6144) 10-bit RAW image sensor,
  controlled over I2C, with a 4-lane MIPI CSI-2 D-PHY output.

maintainers:
  - Victor Fuentes <victor@vlinkz.dev>

allOf:
  - $ref: /schemas/media/video-interface-devices.yaml#

properties:
  compatible:
    const: ovti,ov50d40

  reg:
    maxItems: 1

  clocks:
    description: Input clock (INCK/XVCLK).
    maxItems: 1

  reset-gpios:
    description: Active low GPIO connected to the reset pad of the sensor.
    maxItems: 1

  dovdd-supply:
    description: Interface supply, 1.8 volts.

  avdd-supply:
    description: Analogue supply, 2.8 volts.

  dvdd-supply:
    description: Digital core supply, 1.2 volts.

  port:
    $ref: /schemas/graph.yaml#/$defs/port-base
    additionalProperties: false

    properties:
      endpoint:
        $ref: /schemas/media/video-interfaces.yaml#
        unevaluatedProperties: false

        properties:
          data-lanes:
            items:
              - const: 1
              - const: 2
              - const: 3
              - const: 4

        required:
          - data-lanes
          - link-frequencies

required:
  - compatible
  - reg
  - clocks
  - port

unevaluatedProperties: false

examples:
  - |
    #include <dt-bindings/gpio/gpio.h>

    i2c {
        #address-cells = <1>;
        #size-cells = <0>;

        camera@22 {
            compatible = "ovti,ov50d40";
            reg = <0x22>;
            clocks = <&camera_mclk 0>;
            assigned-clocks = <&camera_mclk 0>;
            assigned-clock-rates = <19200000>;
            reset-gpios = <&gpio1 10 GPIO_ACTIVE_LOW>;
            dovdd-supply = <&vreg_1p8>;
            avdd-supply = <&vreg_2p8>;
            dvdd-supply = <&vreg_1p1>;

            port {
                endpoint {
                    link-frequencies = /bits/ 64 <962400000>;
                    data-lanes = <1 2 3 4>;
                    remote-endpoint = <&mipi_csi2_ep>;
                };
            };
        };
    };
...
```

## Documentation/devicetree/bindings/media/i2c/sony,imx709.yaml
```yaml
# SPDX-License-Identifier: (GPL-2.0-only OR BSD-2-Clause)
%YAML 1.2
---
$id: http://devicetree.org/schemas/media/i2c/sony,imx709.yaml#
$schema: http://devicetree.org/meta-schemas/core.yaml#

title: Sony IMX709 Image Sensor

description:
  Sony IMX709 is a 32 megapixel (6560x4928) 10-bit RAW image sensor,
  controlled over I2C, with a 4-lane MIPI CSI-2 D-PHY output.

maintainers:
  - Victor Fuentes <victor@vlinkz.dev>

allOf:
  - $ref: /schemas/media/video-interface-devices.yaml#

properties:
  compatible:
    const: sony,imx709

  reg:
    maxItems: 1

  clocks:
    description: Input clock (INCK/XVCLK).
    maxItems: 1

  reset-gpios:
    description: Active low GPIO connected to the reset pad of the sensor.
    maxItems: 1

  dovdd-supply:
    description: Interface supply, 1.8 volts.

  avdd-supply:
    description: Analogue supply, 2.9 volts.

  dvdd-supply:
    description: Digital core supply.

  port:
    $ref: /schemas/graph.yaml#/$defs/port-base
    additionalProperties: false

    properties:
      endpoint:
        $ref: /schemas/media/video-interfaces.yaml#
        unevaluatedProperties: false

        properties:
          data-lanes:
            items:
              - const: 1
              - const: 2
              - const: 3
              - const: 4

        required:
          - data-lanes
          - link-frequencies

required:
  - compatible
  - reg
  - clocks
  - port

unevaluatedProperties: false

examples:
  - |
    #include <dt-bindings/gpio/gpio.h>

    i2c {
        #address-cells = <1>;
        #size-cells = <0>;

        camera@10 {
            compatible = "sony,imx709";
            reg = <0x10>;
            clocks = <&camera_mclk 0>;
            assigned-clocks = <&camera_mclk 0>;
            assigned-clock-rates = <19200000>;
            reset-gpios = <&gpio1 10 GPIO_ACTIVE_LOW>;
            dovdd-supply = <&vreg_1p8>;
            avdd-supply = <&vreg_2p8>;
            dvdd-supply = <&vreg_1p1>;

            port {
                endpoint {
                    link-frequencies = /bits/ 64 <375900000>;
                    data-lanes = <1 2 3 4>;
                    remote-endpoint = <&mipi_csi2_ep>;
                };
            };
        };
    };
...
```

## Documentation/devicetree/bindings/media/i2c/sony,imx906.yaml
```yaml
# SPDX-License-Identifier: (GPL-2.0-only OR BSD-2-Clause)
%YAML 1.2
---
$id: http://devicetree.org/schemas/media/i2c/sony,imx906.yaml#
$schema: http://devicetree.org/meta-schemas/core.yaml#

title: Sony IMX906 Image Sensor

description:
  Sony IMX906 is a 50 megapixel (8192x6144) 10-bit RAW image sensor,
  controlled over I2C, with a 3-trio MIPI CSI-2 C-PHY output.

maintainers:
  - Victor Fuentes <victor@vlinkz.dev>

allOf:
  - $ref: /schemas/media/video-interface-devices.yaml#

properties:
  compatible:
    const: sony,imx906

  reg:
    maxItems: 1

  clocks:
    description: Input clock (INCK).
    maxItems: 1

  reset-gpios:
    description: Active low GPIO connected to the reset pad of the sensor.
    maxItems: 1

  dovdd-supply:
    description: Interface supply, 1.8 volts.

  avdd-supply:
    description: Analogue supply, 2.8 volts.

  avdd1p8-supply:
    description: Second analogue supply, 1.8 volts.

  dvdd-supply:
    description: Digital core supply, 1.1 volts.

  port:
    $ref: /schemas/graph.yaml#/$defs/port-base
    additionalProperties: false

    properties:
      endpoint:
        $ref: /schemas/media/video-interfaces.yaml#
        unevaluatedProperties: false

        properties:
          bus-type:
            const: 1 # MIPI CSI-2 C-PHY

          data-lanes:
            description: The three C-PHY trios.
            items:
              - const: 1
              - const: 2
              - const: 3

        required:
          - bus-type
          - data-lanes
          - link-frequencies

required:
  - compatible
  - reg
  - clocks
  - port

unevaluatedProperties: false

examples:
  - |
    #include <dt-bindings/gpio/gpio.h>
    #include <dt-bindings/media/video-interfaces.h>

    i2c {
        #address-cells = <1>;
        #size-cells = <0>;

        camera@1a {
            compatible = "sony,imx906";
            reg = <0x1a>;
            clocks = <&camera_mclk 1>;
            assigned-clocks = <&camera_mclk 1>;
            assigned-clock-rates = <19200000>;
            reset-gpios = <&gpio1 14 GPIO_ACTIVE_LOW>;
            dovdd-supply = <&vreg_1p8>;
            avdd-supply = <&vreg_2p8>;
            avdd1p8-supply = <&vreg_avdd_1p8>;
            dvdd-supply = <&vreg_1p1>;

            port {
                endpoint {
                    bus-type = <MEDIA_BUS_TYPE_CSI2_CPHY>;
                    link-frequencies = /bits/ 64 <1634400000 1020000000>;
                    data-lanes = <1 2 3>;
                    remote-endpoint = <&mipi_csi2_ep>;
                };
            };
        };
    };
...
```
